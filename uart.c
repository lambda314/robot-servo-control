#include "uart.h"

/**********************************************<+><+><+><+><+>★【robot】★<+><+><+><+><+>************************************************
函数名称：uart_init
函数功能：串口1初始化
输入参数：无
输出参数：无
***********************************************<<<<<<<<<<<<<<<★【robot】★>>>>>>>>>>>>>>>************************************************/
void uart1_init(void)
{			
	SCON  = 0x50;				//SM0:SM1->0:1;串口1工作方式1		
	PCON |= 0x80;				//SMOD=1;串口1工作方式1，2,3波特率加倍
	IP   |= 0x10;				//PS=1;
	IPH  |= 0x10;				//PS:PSH->1:1串口1为最高优先级（优先级3）
	BRT   = 0xf4;				//9600	22118400BRT=256-Sysclk*2^SMOD/12/32/BAUD;		
	AUXR |= 0x11;				//BRTR=1;允许独立波特率发生器运行；S1BRS=1独立波特率发生器作为串行口波特率发生器，此时定时器1得到释放，可以作为独立定时器使用			
	ES = 1;
	EA = 1;

}
/**********************************************<+><+><+><+><+>★【robot】★<+><+><+><+><+>************************************************
函数名称：send1_char
函数功能：串口1发送一字节数据
输入    ：无
输出    ：无
***********************************************<<<<<<<<<<<<<<<★【robot】★>>>>>>>>>>>>>>>************************************************/
void send1_char(uchar txd)
{
	SBUF = txd;
	while(!TI);			
	TI = 0;		
}
/**********************************************<+><+><+><+><+>★【robot】★<+><+><+><+><+>************************************************
函数名称：uart2_init
函数功能：串口2初始化
输入参数：无
输出参数：无
***********************************************<<<<<<<<<<<<<<<★【robot】★>>>>>>>>>>>>>>>************************************************/
void uart2_init(void)			//9600bps@22.1184MHz
{	
	AUXR1|= 0x10;       //S2_P4=1;UART2从P1口切换到P4口：RXD2 P1.2->4.2 TXD2 P1.3->P4.3	
	AUXR |= 0x08;		//波特率加倍
	S2CON = 0x50;		//8位数据,可变波特率
	AUXR &= 0xFB;		//独立波特率发生器时钟为Fosc/12,即12T
	IP2  |= 0x01;		//PS2=1;
	IPH2 |= 0x01;		//PS2:PS2H->1:1串口2为最高优先级（优先级3）
	BRT   = 0xF4;		//设定独立波特率发生器重装值9600bps@22.1184MHz
	AUXR |= 0x10;		//启动独立波特率发生器
    IE2  |= 0x01;		//串行口2中断允许位
	EA    =	1;          //CPU开放总中断
}
/**********************************************<+><+><+><+><+>★【robot】★<+><+><+><+><+>************************************************
函数名称：send2_char
函数功能：串口2发送一字节数据
输入    ：无
输出    ：无
***********************************************<<<<<<<<<<<<<<<★【robot】★>>>>>>>>>>>>>>>************************************************/
void send2_char(uchar txd2)
{
	S2BUF = txd2;
	while(!(S2CON&S2TI));	//if uart2 S2TI=1 should end send data		
	S2CON &=~ S2TI;      	//clear uart2 send data mask;(S2TI=0)		
}
/**********************************************<+><+><+><+><+>★【robot】★<+><+><+><+><+>************************************************
函数名称：uart2_reinter();
函数功能：串口2中断服务程序
输入    ：无
输出    ：无
***********************************************<<<<<<<<<<<<<<<★【robot】★>>>>>>>>>>>>>>>************************************************/

void uart2_interrupt() interrupt 8 
{
uchar s2;
    if (S2CON & S2RI)
    {
        S2CON &= ~S2RI;     //Clear receive interrupt flag
		s2=S2BUF;
		send2_char(s2);
    }
    //if (S2CON & S2TI)
    {
        //S2CON &= ~S2TI;     //Clear transmit interrupt flag
		//send2_char(s2);
    }
}